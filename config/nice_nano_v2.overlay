/*
 * Custom I2C pin configuration for nice!nano v2
 * Using pin 7 for SCL and pin 9 for SDA
 */

&i2c0 {
    status = "okay";
    compatible = "nordic,nrf-twi";
    sda-gpios = <&pro_micro 9 GPIO_ACTIVE_HIGH>;
    scl-gpios = <&pro_micro 7 GPIO_ACTIVE_HIGH>;
    clock-frequency = <100000>;
};