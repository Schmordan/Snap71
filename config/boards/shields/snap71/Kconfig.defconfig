## config/boards/shields/snap71/Kconfig.defconfig
```kconfig
if SHIELD_SNAP71_LEFT

config ZMK_KEYBOARD_NAME
    default "snap71"

config ZMK_SPLIT_ROLE_CENTRAL
    default y

endif # SHIELD_SNAP71_LEFT

if SHIELD_SNAP71_LEFT || SHIELD_SNAP71_RIGHT

config ZMK_SPLIT
    default y

endif # SHIELD_SNAP71_LEFT || SHIELD_SNAP71_RIGHT

if SHIELD_SNAP71_RIGHT
    config ZMK_DISPLAY
        default y
endif

if LVGL

config LV_Z_VDB_SIZE
    int
    default 64

config LV_Z_DPI
    int
    default 148

config LV_Z_BITS_PER_PIXEL
    int
    default 1

choice LV_COLOR_DEPTH
    default LV_COLOR_DEPTH_1
endchoice

endif # LVGL
```

## config/boards/shields/snap71/Kconfig.shield
```kconfig
config SHIELD_SNAP71_LEFT
    def_bool $(shields_list_contains,snap71_left)

config SHIELD_SNAP71_RIGHT
    def_bool $(shields_list_contains,snap71_right)
```

## config/boards/shields/snap71zmk/Kconfig.defconfig
```kconfig
if SHIELD_SNAP71ZMK_LEFT

config ZMK_KEYBOARD_NAME
    default "snap71"

config ZMK_SPLIT_ROLE_CENTRAL
    default y

endif # SHIELD_SNAP71ZMK_LEFT

if SHIELD_SNAP71ZMK_LEFT || SHIELD_SNAP71ZMK_RIGHT

config ZMK_SPLIT
    default y

endif # SHIELD_SNAP71ZMK_LEFT || SHIELD_SNAP71ZMK_RIGHT
```
